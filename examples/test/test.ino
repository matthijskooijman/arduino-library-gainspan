#include <GS.h>
#include <ctype.h>
extern "C" {
#include <API/GS_API.h>
#include <AT/AtCmdLib.h>
}

// Geotrust Global CA (used by google.com)
unsigned char cert[] = {0x30, 0x82, 0x03, 0x54, 0x30, 0x82, 0x02, 0x3c, 0xa0, 0x03, 0x02, 0x01, 0x02,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 0xe6, 0x33};

void setup() {
	pinMode(VCC_ENABLE, OUTPUT);
	digitalWrite(VCC_ENABLE, HIGH);
	pinMode(LED_RED, OUTPUT);
	pinMode(LED_GREEN, OUTPUT);
	pinMode(LED_BLUE, OUTPUT);
	digitalWrite(LED_RED, HIGH);
	digitalWrite(LED_GREEN, HIGH);
	digitalWrite(LED_BLUE, HIGH);
	Serial.begin(115200);
	GS_API_Printf("Gainspan Demo 1.0");
	delay(1000);
	GS_API_Init();
	GS_API_PrintModuleInformation();
	GS_API_PrintNetworkInfo();
	while(!GS_API_JoinNetwork())
		GS_API_Printf("Join failed");
	GS_API_Printf("Join success");
	uint8_t ipAddr[GS_API_IP_STR_LENGTH];
	if(GS_API_GetIPAddress(ipAddr)){
		GS_API_Printf("IP: %s", ipAddr);
	}
	AtLibGs_AddCert("geotrust", /* to_flash */ false, cert, sizeof(cert));
	//AtLibGs_SetSoftwareFlowControl(1);
}

static void recv(uint8_t cid, uint8_t c) {
// Don't print here, the debugging code in the GS lib already prints
return;
  static int ignore = -1;
  // Make sure that every \r, \n or \r\n results in printing exactly
  // \r\n, but don't introduce extra linebreaks because of this.
  if (c == ignore) {
    // skip
    ignore = -1;
  } else if (c == '\r') {
    Serial.print("\r\n");
    ignore = '\n';
  } else if (c == '\n') {
    Serial.print("\r\n");
  } else if (isprint(c)) {
    Serial.write(c);
  } else {
    Serial.print('\\');
    Serial.print(c >> 4, HEX);
    Serial.print(c & 0xf, HEX);
  }
  delay(1);
}

void loop() {
	//uint8_t cid = GS_API_CreateTcpClientConnection((char*)"192.168.1.176", (char*)"80", recv);
	uint8_t cid = GS_API_CreateTcpClientConnection((char*)"74.125.136.138", (char*)"443", recv);
	//const uint8_t data[] = "GET / HTTP/1.0\r\n\r\n\xfb\xda ABCD";
	//const uint8_t data[] = {0,0x13, 1,0x13, 2,0x13, 3,0x13, 4,0x13, 5,0x13, 6,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 255,0x13};
	const uint8_t data[] = "GET / HTTP/1.0\r\n\r\n";
	AtLibGs_DoTls(cid, "geotrust", NULL, NULL);
	if (!GS_API_SendTcpData(cid, (uint8_t*)data, sizeof(data) - 1)) {
		GS_API_Printf("Send TCP Data failed");
		delay(5000);
		return;
	}
	for (int i = 0; i < 5000; ++i) {
		GS_API_CheckForData();
		delay(1);
	}
	GS_API_CloseConnection(cid);
	delay(3000);
}

/* vim: set filetype=cpp: */

